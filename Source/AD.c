/*************************************************
Project:                GM8804C-2_ARM
File name:              AD.c
Description:            AD驱动相关函数
Author:                 丛海旭
Version:                1.0
Date:                   2013-12-9
Others:                 IC:CS5532
History:
*************************************************/

#include "include.h"

#define ADSPEED_120  0
#define ADSPEED_240  1
#define ADSPEED_480  2
#define ADSPEED_960  3


#ifdef ADFILTER_02CS
//GM8802C-S仪表的滤波数组
//ADC采用120次/S的速度时使用的滤波参数
const u32 DF0TAB120[]={488,743,1010,1284,1560,1834,2099,2351,2584,2793,2975,3126,3241,3320,3360};
const u32 DF1TAB120[]={289,434,585,741,900,1062,1224,1384,1541,1692,1836,1972,2097,2209,2309,2394,2463,2516,2551,2569};
const u32 DF2TAB120[]={45,141,243,350,462,578,697,818,940,1061,1182,1300,1415,1526,1632,1732,1824,1908,1984,2050,2107,2152,2187,2210,2224};
const u32 DF3TAB120[]={50,115,184,256,331,409,488,569,651,734,817,899,981,1062,1141,1217,1292,1362,1430,1493,1552,1606,1655,1699,1737,1769,1794,1814,1827,1834};
const u32 DF4TAB120[]={19,69,120,172,227,283,341,400,460,521,583,646,708,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1585,1589};
const u32 DF5TAB120[]={16,54,92,132,173,215,258,302,348,394,440,488,535,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1386,1389};
const u32 DF6TAB120[]={12,44,74,104,136,169,203,237,272,308,344,381,418,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1232,1234};
const u32 DF7TAB120[]={9,32,58,83,108,135,162,189,217,246,275,304,334,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1110,1112};
const u32 DF8TAB120[]={19,38,58,78,99,120,142,164,186,209,233,256,280,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1000,1002};
const u32 DF9TAB120[]={11,27,44,61,78,96,114,132,151,170,190,210,230,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923,926};
const u32 DFNUMBER120[]={30,40,50,60,70,80,90,100,110,120};
static u32 const DEF_FILTER120[]={65536,65536,65536,65536,65536,65536,65536,65536,65536,65536};
const u32* pu32DFTab_120[10]={DF0TAB120,DF1TAB120,DF2TAB120,DF3TAB120,DF4TAB120,DF5TAB120,DF6TAB120,DF7TAB120,DF8TAB120,DF9TAB120};

//ADC采用240次/S的速度时使用的滤波参数  
u32 const DF0TAB240[]={0,15207,42219,79705,125558,177052,231039,284190,333236,375212,407679,428902};
u32 const DF1TAB240[]={0,2895,7219,12936,19980,28267,37686,48107,59385,71357,83846,96671,109640,122560,135241,147494,159140,170009,179947,188814,196492,202882,207909,211522};
u32 const DF2TAB240[]={0,1162,2741,4732,7127,9916,13083,16611,20480,24668,29148,33894,38875,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138953,140324};
u32 const DF3TAB240[]={9,18,47,98,179,296,461,685,984,1375,1877,2510,3296,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145874,146615};
u32 const DF4TAB240[]={7,12,26,51,89,142,214,308,431,586,781,1023,1318,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116695,117073};
u32 const DF5TAB240[]={6,9,17,31,52,80,118,166,227,303,397,511,648,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97219,97437};
u32 const DF6TAB240[]={5,7,12,21,33,50,73,101,136,178,230,291,365,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83303,83440};
u32 const DF7TAB240[]={4,5,9,15,23,34,48,66,88,114,145,183,226,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72868,72959};
u32 const DF8TAB240[]={4,5,7,11,17,24,34,46,61,78,98,122,150,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64753,64817};
u32 const DF9TAB240[]={3,4,6,9,13,18,25,34,44,56,70,87,105,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58263,58310};
u32 const DFNUMBER240[]={24,48,72,96,120,144,168,192,216,240};
static u32 const DEF_FILTER240[]={4999998,4999998,5000004,5000000,5000002,5000006,5000000,4999996,5000004,4999998};
const u32* pu32DFTab_240[10]={DF0TAB240,DF1TAB240,DF2TAB240,DF3TAB240,DF4TAB240,DF5TAB240,DF6TAB240,DF7TAB240,DF8TAB240,DF9TAB240};
//ADC采用480次/S的速度时使用的滤波参数
static u32 const DF0TAB480[] = {0,2895,7219,12936,19981,28267,37686,48108,59385,71357,83847,96671,109640,122560,135241,147494,159140,170009,179947,188814,196492,202882,207909,211522};
static u32 const DF1TAB480[] = {0,619,1413,2380,3519,4827,6300,7934,9725,11667,13753,15978,18333,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104272,104978};
static u32 const DF2TAB480[] = {0,260,572,935,1348,1812,2326,2890,3503,4163,4871,5626,6426,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69521,69807};
static u32 const DF3TAB480[] = {4,5,9,15,23,34,48,66,88,114,145,183,226,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72867,72959};
static u32 const DF4TAB480[] = {3,4,6,9,13,18,25,34,44,56,70,87,105,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58263,58309};
static u32 const DF5TAB480[] = {3,3,4,6,8,11,15,20,26,32,40,48,58,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48532,48559};
static u32 const DF6TAB480[] = {2,3,3,4,6,8,10,13,16,20,25,30,36,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41585,41602};
static u32 const DF7TAB480[] = {2,2,3,3,4,6,7,9,11,14,17,20,24,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36377,36389};
static u32 const DF8TAB480[] = {2,2,2,3,4,4,6,7,8,10,12,14,17,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32328,32336};
static u32 const DF9TAB480[] = {2,2,2,2,3,4,4,5,6,8,9,11,13,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29090,29096};
static u32 const DEF_FILTER480[] = {5000004,5000000,4999996,4999992,4999992,4999998,4999994,4999992,4999992,4999998};
static u32 const DFNUMBER480[] = {48,96,144,192,240,288,336,384,432,480};
const u32* pu32DFTab_480[10]={DF0TAB480,DF1TAB480,DF2TAB480,DF3TAB480,DF4TAB480,DF5TAB480,DF6TAB480,DF7TAB480,DF8TAB480,DF9TAB480};

#else

u32 const DFNUMBER[]={19,27,35,43,51,59,67,75,83,91};
//各级滤波系数表
u32 const DFTAB0[]={76,163,256,351,443,527,597,651,684,696};
                    /*6*/
u32 const DFTAB1[]={13,57,105,156,209,263,315,364,409,447,479,502,516,522};
                    /*4.5*/
u32 const DFTAB2[]={4,29,56,86,117,149,182,214,245,275,303,328,351,370,385,396,403,406};
                    /*3.50*/
u32 const DFTAB3[]={6,22,41,59,79,99,119,140,161,181,201,220,238,255,270,284,296,306,314,320,323,324};
                    /*2.8*/
u32 const DFTAB4[]={1,12,25,38,52,66,81,95,110,126,141,155,170,184,197,210,222,233,243,252,259,265,270,274,276,278,};
                    /*2.39*/
u32 const DFTAB5[]={1,9,19,28,38,48,59,70,81,92,103,115,126,137,147,158,
                    168,177,186,195,203,210,217,222,227,231,234,237,238,240};
                    /*2.06*/
u32 const DFTAB6[]={1,8,15,23,30,38,46,54,63,71,80,88,97,105,114,122,130,138,
                    146,153,160,167,173,179,184,189,194,198,201,204,206,207,208,208,};
                    /*1.8*/
u32 const DFTAB7[]={1,7,12,18,24,30,36,42,49,56,62,69,76,83,90,97,103,110,116,
                    123,129,135,141,146,151,156,161,165,169,173,176,179,181,182,184,185,186,186};
                    /*1.61*/
u32 const  DFTAB8[]={2,6,10,15,20,24,29,35,40,45,51,56,62,67,73,78,84,89,
                     95,100,105,110,115,120,125,130,134,138,142,146,149,152,
                     155,158,160,162,164,165,166,167,168,168};
                   /*1.45*/
u32 const  DFTAB9[]={3,6,10,14,17,21,26,30,34,38,43,47,52,56,61,65,70,74,
                     79,83,88,92,96,100,104,108,112,116,120,123,126,129,
                     132,135,138,140,142,144,146,147,149,150,151,151,152,152};
                   //1.31

#define DFCOESUM  8192
static u32 const DEF_FILTER[]={8192,8192,8192,8192,8192,8192,8192,8192,8192,8192};
const u32* pu32DFTab[10]={DFTAB0,DFTAB1,DFTAB2,DFTAB3,DFTAB4,DFTAB5,DFTAB6,DFTAB7,DFTAB8,DFTAB9};

#endif





//读cs5532输出
#define ADC_DOUT_READ   GPIO_BitRead(GPIO0,0)
//#define ADC_DOUT_CLR    GPIO_BitWrite(GPIO0,0,0)
//#define ADC_DOUT_SET    GPIO_BitWrite(GPIO0,0,1)
//写cs5532输入端口
#define ADC_DIN_CLR     GPIO_BitWrite(GPIO0,1,0)
#define ADC_DIN_SET     GPIO_BitWrite(GPIO0,1,1)
//写cs5532时钟端口
#define ADC_CLK_CLR     GPIO_BitWrite(GPIO0,2,0)
#define ADC_CLK_SET     GPIO_BitWrite(GPIO0,2,1)


//同步字符 以及同步字符 字长度
#define  ADCOM_SYNC1        0XFF
#define  ADCOM_SYNC0        0XFE
#define  ADCOM_SYNC1_NUM    15
#define  ADCOM_SYNC0_NUM    1

#define ADCOM_WOFFSETR      0X01    //写偏移寄存器
#define ADCOM_WGAINR        0X02    //写增益寄存器
#define ADCOM_WCFGR         0X03    //写配置寄存器
#define ADCOM_RCFGR         0X0B    //读配置寄存器
#define ADCOM_WCANNELR      0X05    //写通道设置寄存器

#define ADDAT_CFG_RESET 0x22000000  //复位
#define ADDAT_CFG_NRM   0x02000000  //正常
#define ADDAT_OSR_0     0x00000000  //Offset==0
#define ADDAT_GR_1      0x01000000  //Gain  == 1
#define ADDAT_CR_3840   0x04400440  //3840次/秒
#define ADDAT_CR_1920   0x04C004C0  //1920次/秒
#define ADDAT_CR_960    0x05400540  //960次/秒
#define ADDAT_CR_480    0x05C005C0  //480次/秒
#define ADDAT_CR_240    0x06400640  //240次/秒
#define ADDAT_CR_120    0x00400040  //120次/秒
#define ADDAT_CR_60     0x00C000C0  //60次/秒

#define ADCOM_ADStar        0XC0
#define ADCOM_KEEP          0X00

bool gb_AdErrFlg;           //AD错误标志
bool gb_AdOKFlg;            //AD初始化成功标志位
bool gb_AdOflFlg;           //AD溢出标志位
bool gb_OflFlg;             //重量溢出标志位
bool gb_SigWtFlg;             //符号标志

#ifdef ADFILTER_02CS
#define ADQUEUE_LENGTH  480
u32 gu32_AdQueue[ADQUEUE_LENGTH];       //AD采样队列
#else
#define ADQUEUE_LENGTH  92
u32 gu32_AdQueue[ADQUEUE_LENGTH];       //AD采样队列
#endif


u32 gu32_AdValue;           //AD转换得到的数据

/*********************************************************************
函数名称: void AD_SendByte(u8 outdata)
功    能: 写入ADC一字节数据
说    明: 底层驱动
入口参数: outdata = 发送的数据
返 回 值: 
设    计: 丛海旭               时    间: 2013-12-10
修    改:                      时    间: 
*********************************************************************/
void AD_SendByte(u8 outdata)
{
    u8 i;
    for (i = 0; i < 8; i++)
    {
        (outdata & 0x80) ? ADC_DIN_SET:ADC_DIN_CLR;
        __nop();
        ADC_CLK_SET;
        __nop();
        outdata <<= 1;
        ADC_CLK_CLR;
        __nop();
    }
}

/*********************************************************************
函数名称: u8 AD_ReceiveByte(void)
功    能: 从ADC读出一字节数据
说    明: 底层驱动
入口参数: 
返 回 值: 
设    计: 丛海旭               时    间: 2013-12-10
修    改:                      时    间: 
*********************************************************************/
u8 AD_ReceiveByte(void)
{
    u8 i;
    u8 indata = 0;
    for (i = 0; i < 8; i++)
    {
        indata <<= 1;
        if(ADC_DOUT_READ == 1)
            indata |= 0X01;
        ADC_CLK_SET;
        __nop();
        ADC_CLK_CLR;
        __nop();

    }
    return indata;
}

/*********************************************************************
函数名称: void AD_WriteReg(u8 u8AdCOM,u32 u32AdRegVal)
功    能: 写ADC寄存器
说    明: 底层驱动
入口参数: 
返 回 值: u8AdCOM：寄存器地址 u32AdRegVal：寄存器值
设    计: 丛海旭               时    间: 2013-12-10
修    改:                      时    间: 
*********************************************************************/
void AD_WriteReg(u8 u8AdCOM,u32 u32AdRegVal)
{
    u8 i;
    ULDATA uADData;
    uADData.ul=u32AdRegVal;
    AD_SendByte(u8AdCOM);
    for(i=0;i<4;i++){
        AD_SendByte(uADData.uc[3-i]); //ARM 小端模式//先发送高位
    }
}

/*********************************************************************
函数名称: u32 AD_ReadReg(u8 u8AdCOM)
功    能: 读ADC寄存器
说    明: 底层驱动
入口参数: 
返 回 值: 
设    计: 丛海旭               时    间: 2013-12-10
修    改:                      时    间: 
*********************************************************************/
u32 AD_ReadReg(u8 u8AdCOM)
{
    ULDATA u32AdRegVal;
    u8 i;
    AD_SendByte(u8AdCOM);
    for (i = 0; i < 4; i++)
        u32AdRegVal.uc[3-i] = AD_ReceiveByte();//ARM 小端模式//先接收的是高位
    return u32AdRegVal.ul;
}

/*********************************************************************
函数名称: void AD_SYNC(void)
功    能: 发送同步命令
说    明: 底层驱动
入口参数: 
返 回 值: 
设    计: 丛海旭               时    间: 2013-12-10
修    改:                      时    间: 
*********************************************************************/
void AD_SYNC(void)
{
    u8 i;
    for (i = 0; i < ADCOM_SYNC1_NUM; i++)
        AD_SendByte(ADCOM_SYNC1);
    for (i = 0; i < ADCOM_SYNC0_NUM; i++)
        AD_SendByte(ADCOM_SYNC0);
}

/*********************************************************************
函数名称: bool AD_Init(u8 i)
功    能: 初始化AD
说    明: 底层驱动
入口参数: i:对应AD采样速度120 240 480 960 
返 回 值: 
设    计: 丛海旭               时    间: 2013-12-10
修    改:                      时    间: 
*********************************************************************/
bool AD_Init(u8 i)
{
    u8 u8reInitNum=0;
    u32 u32CfgRegVal;
    u32 lu32_Temp;
    
    switch (i)
    {
        default:
        case 0:
            lu32_Temp = ADDAT_CR_120;
            break;
        case 1:
            lu32_Temp = ADDAT_CR_240;
            break;
        case 2:
            lu32_Temp = ADDAT_CR_480;
            break;
        case 3:
            lu32_Temp = ADDAT_CR_960;
            break;
    }
    
    //标准TTL输入，GPIO_IN_TRI_CMOS高阻模拟输入
    GPIO_Config(GPIO0, (1<<0), GPIO_IN_TRI_TTL);
    //推挽输出GPIO_OUT_PP
    GPIO_Config(GPIO0, (1<<1), GPIO_OUT_PP);
    //时钟 推挽输出
    GPIO_Config(GPIO0, (1<<2), GPIO_OUT_PP);
    
    do{
        //判断重新初始化次数是否已经超出，超出则AD初始化失败
        if (u8reInitNum >= 4)
        {
            gb_AdErrFlg = true;
            return false;
        }
        AD_SYNC();      //发同步字符初始化到命令模式
        AD_WriteReg(ADCOM_WCFGR, ADDAT_CFG_RESET); //写复位命令
        u8reInitNum++;  //自加 AD重初始化次数
        u32CfgRegVal = AD_ReadReg(ADCOM_RCFGR); //读配置寄存器
    }while(u32CfgRegVal != 0x10000000);     //已经复位成功则继续

    AD_WriteReg(ADCOM_WOFFSETR, ADDAT_OSR_0);      //写偏移寄存器 偏移量为0
    AD_WriteReg(ADCOM_WGAINR, ADDAT_GR_1);         //写增益寄存器 增益为1
    AD_WriteReg(ADCOM_WCFGR, ADDAT_CFG_NRM);       //写配置寄存器 参考电压设置为1V~2.5V
    //写通道设置寄存器 物理通道1 增益1 转换次数120 单极性
    AD_WriteReg(ADCOM_WCANNELR, lu32_Temp);
    AD_SendByte(ADCOM_ADStar);    //AD执行连续转换
    delay(1);
    gb_AdErrFlg = false;
    return true;            //初始化成功
}


u32 DEFSUMTab(u8 dflevel)
{
    if (dflevel > 9)
        dflevel = 5;
#ifdef ADFILTER_02CS
    switch (gs_Setup.AdSamplingRate)
    {
        case ADSPEED_120:
            return (DEF_FILTER120[dflevel]);
        case ADSPEED_240:
            return (DEF_FILTER240[dflevel]);
        case ADSPEED_480:
        case ADSPEED_960:
        default:
            return (DEF_FILTER480[dflevel]);
    }
#else
    return (DEF_FILTER[dflevel]);
#endif
}



/*程序的入口是滤波的级数，而出口是指向该级数的表格的指针*/
const u32* FilterTab(u8 dflevel)
{
    if (dflevel > 9)
        dflevel = 5;
#ifdef ADFILTER_02CS
    switch (gs_Setup.AdSamplingRate)
    {
        case ADSPEED_120:
            return (pu32DFTab_120[dflevel]);
        case ADSPEED_240:
            return (pu32DFTab_240[dflevel]);
        case ADSPEED_480:
        case ADSPEED_960:
        default:
            return (pu32DFTab_480[dflevel]);
    }
#else
    return (pu32DFTab[dflevel]);
#endif
}

/*程序的入口是滤波的级数，而出口是指向该级数的表格的指针*/
u32 DFNumberTab(u8 dflevel)
{
    if (dflevel > 9)
        dflevel = 5;
#ifdef ADFILTER_02CS
    switch (gs_Setup.AdSamplingRate)
    {
        case ADSPEED_120:
            return (DFNUMBER120[dflevel]);
        case ADSPEED_240:
            return (DFNUMBER240[dflevel]);
        case ADSPEED_480:
        case ADSPEED_960:
        default:
            return (DFNUMBER480[dflevel]);
    }
#else
    return (DFNUMBER[dflevel]);
#endif
}

/*********************************************************************
函数名称: void Refresh_RefreshAdArray(bool* fb_RefreshFlg, u32* fu32p_AdArray, u32 fu32_Num)
功    能: 刷新采样数组队列
说    明: 
入口参数: fb_RefreshFlg=刷新标志位地址
          fu32p_AdArray=AD采样队列地址
          fu32_Num=滤波算法数据个数
返 回 值: 
设    计: 丛海旭               时    间: 2015-07-08
修    改:                      时    间: 
*********************************************************************/
#ifdef REFRESH_AT_SP23_MAX
void Refresh_RefreshAdArray(bool* fb_RefreshFlg, u32* fu32p_AdArray, u32 fu32_Num)
{
//    u32 lu32_Temp;
    u32 lu32_Temp1;
    u16 i;
    
    if (*fb_RefreshFlg)
    {   //刷新采样数组
//        lu32_Temp = fu32_Num / 3;   //用2个数据平均值刷新后面的数组
//        lu32_Temp = 2;   //用2个数据平均值刷新后面的数组
//        if (lu32_Temp > 0)
//        {
//            for (i = 0; i < lu32_Temp; i++)
//            {   //计算总和
//                lu32_Temp1 += fu32p_AdArray[0] + fu32p_AdArray[1][i];
//            }
            lu32_Temp1 = (fu32p_AdArray[0] + fu32p_AdArray[1]) / 2;
//            lu32_Temp1 /= lu32_Temp;    //算平均值
            for (i = 2; i < fu32_Num; i++)
            {   //刷新后续数组
                fu32p_AdArray[i] = lu32_Temp1;
            }
            *fb_RefreshFlg = false;
//        }
//        else
//        {
//            *fb_RefreshFlg = false;
//        }
    }
}
#endif

/*********************************************************************
函数名称: u32 Ad_Filter(u32 ful_AdResult, u32 fu32_FLevel)
功    能: AD滤波处理
说    明: 参考单片机版本c2程序
入口参数: ful_AdResult：AD转换结果。fu32_FLevel：滤波级数
返 回 值: 
设    计: 丛海旭               时    间: 2013-12-10
修    改:                      时    间: 
*********************************************************************/
u32 Ad_Filter(u32 ful_AdResult, u32 fu32_FLevel)
{
    u32  sumnumber;
    u32  i,j;
    const u32 *adtpoint;
    u64 adresult;
    u32 *adpoint1;
    u32 *adpoint2;
    
    //-------------------------------------------------
    /*加料、定值和卸料过程中的滤波参数可以自由设置，滤波参数由小切换到大后，由于参与滤波计算的数组
    变长，可能出现重量跳变问题。如卸料时滤波较小，卸料完成后变为大滤波，由于滤波数组变长，后面增加
    的长度里面的数据要比前面的大（因为卸料过程重量是减小状态），可能导致滤波切换时重量变大问题。
    为防止以上问题，在滤波参数变化前，进行采样数组刷新，用当前数组中的平均值来刷新后面的数组值。*/
    //测试效果滤波级数切换时会有重量跳变，改用当前滤波后的数据来刷新数组 2015-7-28 丛海旭
    static u32 su32_FLevel = 9;
    if (fu32_FLevel > su32_FLevel)
    {   //滤波参数由小变大刷新增加后的数组中重量
//         for (i = 0, adresult = 0; i < DFNumberTab(su32_FLevel); i++)
//            adresult += gu32_AdQueue[i];
//        adresult /= i;
//        //刷新后面的数组值为计算的平均值
        //刷新后面的数组为上次滤波值
        
        for (j = DFNumberTab(su32_FLevel); j < DFNumberTab(fu32_FLevel); j++)
            gu32_AdQueue[j] = gu32_AdFedValue;
    }
    su32_FLevel = fu32_FLevel;
    //---------------------------------------------------
#ifdef REFRESH_AT_SP23_MAX
    Refresh_RefreshAdArray(&gb_RefreshAdArrayFlg, gu32_AdQueue, DFNumberTab[fu32_FLevel]);
#endif
    //将采样数组后移，新数据存入数组gu32_AdQueue[0]中
    adpoint1 = gu32_AdQueue + ADQUEUE_LENGTH - 1;
    adpoint2 = gu32_AdQueue + ADQUEUE_LENGTH - 2;
    for(; adpoint1 > gu32_AdQueue ;adpoint1--, adpoint2--)
        *adpoint1 = *adpoint2;
    adpoint1 = gu32_AdQueue;
    *adpoint1 = ful_AdResult;

    adresult = 0;
    adtpoint = FilterTab(fu32_FLevel);         /*指针指向对应的表格*/
#ifdef ADFILTER_02CS    //02CS滤波计算数组个数是偶数
    sumnumber = DFNumberTab(fu32_FLevel) / 2;        /*取得系数的个数*/
    //因为滤波数组前后的数据是相同的，所以下面这样计算可以节省一半的循环时间
    for (i = 0; i < sumnumber; i++, adtpoint++)
        adresult += ((u64)(*adtpoint) * (gu32_AdQueue[i] + gu32_AdQueue[DFNumberTab(fu32_FLevel)-1-i]));
    adresult /= DEFSUMTab(fu32_FLevel);
#else   //04C2滤波计算数组个数是奇数
    sumnumber = (DFNumberTab(fu32_FLevel) - 1) / 2;        /*取得系数的个数*/
    //因为滤波数组前后的数据是相同的，所以下面这样计算可以节省一半的循环时间
    for (i = 0; i < sumnumber; i++, adtpoint++)
        adresult += ((*adtpoint) * (gu32_AdQueue[i] + gu32_AdQueue[DFNumberTab(fu32_FLevel)-1-i]));
    adresult += ((*(adtpoint)) * gu32_AdQueue[sumnumber]);
    adresult /= DEFSUMTab(fu32_FLevel);
#endif
    return(adresult);
}

/*********************************************************************
函数名称: u32 AD_GetFedVal(u32 fu32_FLevel)
功    能: 得到滤波后的AD码
说    明: 
入口参数: 
返 回 值: 
设    计: 丛海旭               时    间: 2013-12-10
修    改:                      时    间: 
*********************************************************************/
u32 AD_GetFedVal(u32 fu32_FLevel)
{
    ULDATA ULADVal;
    static u32 su32_AdTaskTime;
    u32 lu32_Ad;
    
    gb_AdOflFlg = false;
    
    if (gb_AdOKFlg == false)     //如果之前AD初始化不成功则重新初始化
    {
        if (gu32_Sys10ms - su32_AdTaskTime > 5)      //超过50ms初始化一次
        {
            gb_AdOKFlg = AD_Init(gs_Setup.AdSamplingRate);
            su32_AdTaskTime = gu32_Sys10ms;
        }
        gu32_AdValue = 0;
    }
    else
    {
        while(ADC_DOUT_READ)//AD未准备好
        {
            //如果超过50msAD转换还未准备好则重新初始化AD
            //120/s的AD转换速率，每次AD转换大概8.3ms，50ms时间足够AD转换完成6次了
            if (gu32_Sys10ms - su32_AdTaskTime > 5)
            {
                gb_AdOKFlg = AD_Init(gs_Setup.AdSamplingRate);
                su32_AdTaskTime = gu32_Sys10ms;
                gu32_AdValue = 0;
            }
        }
        if (ADC_DOUT_READ == 0)
        {
            su32_AdTaskTime = gu32_Sys10ms;
            ULADVal.ul = AD_ReadReg(ADCOM_KEEP);
            gu32_AdValue = ULADVal.ul >> (8+5); //获取32-(8+5)=19位AD码
        }
    }
    lu32_Ad = Ad_Filter(gu32_AdValue, fu32_FLevel);  //使用单片机版仪表的滤波算法
    gb_SigWtFlg = false;
    gb_OflFlg = false;
    if (lu32_Ad > 0x7FFC0)                   //ad转换结果过大溢出
    {
        gb_AdOflFlg = true;
        gb_OflFlg = true;
    }
    else if (lu32_Ad < 0x1F)                 //ad转换结果过小溢出
    {
        gb_AdOflFlg = true;
        gb_OflFlg = true;
        gb_SigWtFlg = true;
    }
    return lu32_Ad;
        
}

/*********************************************************************
函数名称: u32 AD_ConvertTimes(u32 fu32_SysTime)
功    能: 独立的功能函数，测试实际程序中每秒钟所能达到的AD转换次数
说    明: 查询式AD转换可以放在主循环中，中断时AD转换可放在中断中
入口参数: 系统时间，10ms
返 回 值: AD转换  次/秒
设    计: 丛海旭               时    间: 2014-2-11
修    改:                      时    间: 
*********************************************************************/
u32 AD_ConvertTimes(u32 fu32_SysTime)
{
    static u32 su32_AdTimes = 0;
    static u32 su32_TimeTemp = 0;
    static u32 su32_Result = 0;
    
    if (fu32_SysTime - su32_TimeTemp >= 100)    //1秒钟
    {    
        su32_TimeTemp = fu32_SysTime;
        su32_AdTimes++;
        su32_Result = su32_AdTimes;
        su32_AdTimes = 0;
    }
    else
        su32_AdTimes++;
    
    return su32_Result;
}


